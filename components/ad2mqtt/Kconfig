## components/ad2mqtt/Kconfig
```kconfig
menu "AD2iot * mqtt client"
    config AD2IOT_MQTT_CLIENT
        bool "MQTT client"
        default n
        help
            Enable MQTT notification client(beta)
endmenu
```

## components/ftpd/Kconfig
```kconfig
menu "AD2iot * FTP daemon"
    config AD2IOT_FTP_DAEMON
        bool "Enable FTP daemon"
        default n
        help
            Enable simple ftp server for content updates on uSD device.
endmenu
```

## components/otaupdate/Kconfig
```kconfig
menu "AD2iot * Firmware update support OTA."
    config AD2IOT_OTAUPDATE
        bool "OTA Firmware Updates"
        default n
        help
            Enable OTA firmware updates.
endmenu
```

## components/pushover/Kconfig
```kconfig
menu "AD2iot * Pushover.net client"
    config AD2IOT_PUSHOVER_CLIENT
        bool "Pushover.net client"
        default n
        help
            Enable Pushover.net notification client
endmenu
```

## components/ser2sock/Kconfig
```kconfig
menu "AD2iot * ser2sock server daemon"
    config AD2IOT_SER2SOCKD
        bool "ser2sock server daemon"
        default n
        help
            Enable ser2sock server daemon
endmenu
```

## components/twilio/Kconfig
```kconfig
menu "AD2iot * Twilio client"
    config AD2IOT_TWILIO_CLIENT
        bool "Twilio client"
        default n
        help
            Enable Twilio client
endmenu
```

## components/usdupdate/Kconfig
```kconfig
menu "AD2iot * Firmware update from uSD."
    config AD2IOT_USDUPDATE
        bool "uSD Firmware Updates"
        default n
        help
            Enable uSD firmware updates.
endmenu
```

## components/webUI/Kconfig
```kconfig
menu "AD2iot * WEB Server UI"
    config AD2IOT_WEBSERVER_UI
        bool "WEB Server user interface"
        default n
        help
            Enable simple web server alarm keypad and control panel.
endmenu
```

## main/Kconfig.projbuild
```kconfig
menu "AlarmDecoder IoT Configuration (AD2iot)"

config AD2IOT_TOP
    bool "Enable TOP command"
    default y
    help
        Enable support for TOP command and background task to monitor FreeRTOS tasks.

config AD2IOT_USE_WIFI
    bool "Enable WiFi driver"
    default y
    help
        Enable support for IPV4 sockets for ser2sock client/server.

config AD2IOT_USE_ETHERNET
    bool "Enable Ethernet driver"
    default y
    help
        Enable support for IPV4 sockets for ser2sock client/server.

if AD2IOT_USE_ETHERNET
    choice AD2IOT_ETHERNET_TYPE
        prompt "Ethernet Type"
        default AD2IOT_USE_INTERNAL_ETHERNET if IDF_TARGET_ESP32
        default AD2IOT_USE_DM9051 if !IDF_TARGET_ESP32
        help
            Select which kind of Ethernet will be used in the example.

        config AD2IOT_USE_INTERNAL_ETHERNET
            depends on IDF_TARGET_ESP32
            select ETH_USE_ESP32_EMAC
            bool "Internal EMAC"
            help
                Select internal Ethernet MAC controller.

        config AD2IOT_USE_DM9051
            bool "DM9051 Module"
            select ETH_USE_SPI_ETHERNET
            select ETH_SPI_ETHERNET_DM9051
            help
                Select external SPI-Ethernet module.
    endchoice # AD2IOT_ETHERNET_TYPE

    if AD2IOT_USE_INTERNAL_ETHERNET
        choice AD2IOT_ETH_PHY_MODEL
            prompt "Ethernet PHY Device"
            default AD2IOT_ETH_PHY_LAN8720
            help
                Select the Ethernet PHY device to use in the example.

            config AD2IOT_ETH_PHY_IP101
                bool "IP101"
                help
                    IP101 is a single port 10/100 MII/RMII/TP/Fiber Fast Ethernet Transceiver.
                    Goto http://www.icplus.com.tw/pp-IP101G.html for more information about it.

            config AD2IOT_ETH_PHY_RTL8201
                bool "RTL8201/SR8201"
                help
                    RTL8201F/SR8201F is a single port 10/100Mb Ethernet Transceiver with auto MDIX.
                    Goto http://www.corechip-sz.com/productsview.asp?id=22 for more information about it.

            config AD2IOT_ETH_PHY_LAN8720
                bool "LAN8720"
                help
                    LAN8720A is a small footprint RMII 10/100 Ethernet Transceiver with HP Auto-MDIX Support.
                    Goto https://www.microchip.com/LAN8720A for more information about it.

            config AD2IOT_ETH_PHY_DP83848
                bool "DP83848"
                help
                    DP83848 is a single port 10/100Mb/s Ethernet Physical Layer Transceiver.
                    Goto http://www.ti.com/product/DP83848J for more information about it.
        endchoice

        config AD2IOT_ETH_MDC_GPIO
            int "SMI MDC GPIO number"
            default 23
            help
                Set the GPIO number used by SMI MDC.

        config AD2IOT_ETH_MDIO_GPIO
            int "SMI MDIO GPIO number"
            default 18
            help
                Set the GPIO number used by SMI MDIO.
    endif # AD2IOT_USE_INTERNAL_ETHERNET

    if AD2IOT_USE_DM9051
        config AD2IOT_DM9051_SPI_HOST
            int "SPI Host Number"
            range 0 2
            default 1
            help
                Set the SPI host used to communicate with DM9051.

        config AD2IOT_DM9051_SCLK_GPIO
            int "SPI SCLK GPIO number"
            range 0 33
            default 19
            help
                Set the GPIO number used by SPI SCLK.

        config AD2IOT_DM9051_MOSI_GPIO
            int "SPI MOSI GPIO number"
            range 0 33
            default 23
            help
                Set the GPIO number used by SPI MOSI.

        config AD2IOT_DM9051_MISO_GPIO
            int "SPI MISO GPIO number"
            range 0 33
            default 25
            help
                Set the GPIO number used by SPI MISO.

        config AD2IOT_DM9051_CS_GPIO
            int "SPI CS GPIO number"
            range 0 33
            default 22
            help
                Set the GPIO number used by SPI CS.

        config AD2IOT_DM9051_SPI_CLOCK_MHZ
            int "SPI clock speed (MHz)"
            range 20 80
            default 20
            help
                Set the clock speed (MHz) of SPI interface.

        config AD2IOT_DM9051_INT_GPIO
            int "Interrupt GPIO number"
            default 4
            help
                Set the GPIO number used by DM9051 interrupt.
    endif # AD2IOT_USE_DM9051

    config AD2IOT_ETH_PHY_RST_GPIO
        int "PHY Reset GPIO number"
        default 5
        help
            Set the GPIO number used to reset PHY chip.
            Set to -1 to disable PHY chip hardware reset.

    config AD2IOT_ETH_PHY_POWER_GPIO
        int "PHY Powercontrol GPIO number"
        default 12
        help
            Set the GPIO number used to enable power on PHY chip.

    config AD2IOT_ETH_PHY_ADDR
        int "PHY Address"
        range 0 31 if AD2IOT_USE_INTERNAL_ETHERNET
        range 1 1 if !AD2IOT_USE_INTERNAL_ETHERNET
        default 1
        help
            Set PHY address according your board schematic.
endif # AD2IOT_USE_ETHERNET

endmenu
```

## sdkconfig.defaults
```kconfig
# GENERAL
CONFIG_FREERTOS_UNICORE=y
CONFIG_OPTIMIZATION_LEVEL_RELEASE=y
CONFIG_BOOTLOADER_LOG_LEVEL_NONE=y
CONFIG_BOOTLOADER_LOG_LEVEL=0
CONFIG_ESPTOOLPY_FLASHMODE_QIO=y
CONFIG_BOOTLOADER_SPI_WP_PIN=7
CONFIG_ESPTOOLPY_FLASHSIZE="4MB"
CONFIG_ESPTOOLPY_FLASHSIZE_4MB=y
CONFIG_PARTITION_TABLE_CUSTOM=y
CONFIG_PARTITION_TABLE_CUSTOM_FILENAME="partitions.4MB.csv"
CONFIG_PARTITION_TABLE_FILENAME="partitions.4MB.csv"
CONFIG_PARTITION_TABLE_OFFSET=0x8000
CONFIG_PARTITION_TABLE_MD5=y
# CONFIG_FATFS_LFN_NONE is not set
CONFIG_FATFS_LFN_HEAP=y
CONFIG_FATFS_CODEPAGE_437=y
CONFIG_FATFS_CODEPAGE=437
CONFIG_FATFS_CODEPAGE_437=y
CONFIG_FATFS_MAX_LFN=255
CONFIG_FATFS_API_ENCODING_ANSI_OEM=y
CONFIG_FATFS_FS_LOCK=0
CONFIG_FATFS_TIMEOUT_MS=10000
CONFIG_FATFS_PER_FILE_CACHE=y
CONFIG_FREERTOS_USE_TRACE_FACILITY=y
CONFIG_FREERTOS_USE_STATS_FORMATTING_FUNCTIONS=y
CONFIG_FREERTOS_VTASKLIST_INCLUDE_COREID=y
CONFIG_FREERTOS_GENERATE_RUN_TIME_STATS=y
CONFIG_FREERTOS_RUN_TIME_STATS_USING_ESP_TIMER=y
CONFIG_COMPILER_CXX_EXCEPTIONS=y
CONFIG_CXX_EXCEPTIONS=y
CONFIG_COMPILER_CXX_EXCEPTIONS_EMG_POOL_SIZE=0
CONFIG_CXX_EXCEPTIONS_EMG_POOL_SIZE=0

# ESP32-POE-ISO ETHERNET
CONFIG_ETH_USE_ESP32_EMAC=y
CONFIG_ETH_PHY_INTERFACE_RMII=y
CONFIG_ETH_RMII_CLK_OUT_GPIO=17
CONFIG_ETH_RMII_CLK_OUTPUT=y
CONFIG_AD2IOT_ETH_PHY_LAN8720=y
CONFIG_AD2IOT_ETH_MDC_GPIO=23
CONFIG_AD2IOT_ETH_MDIO_GPIO=18
CONFIG_AD2IOT_ETH_PHY_RST_GPIO=-1
CONFIG_AD2IOT_ETH_PHY_POWER_GPIO=12
CONFIG_AD2IOT_ETH_PHY_ADDR=0

# DEFAULT COMPONENTS & SETTINGS
CONFIG_LWIP_LOCAL_HOSTNAME="ad2iot"
CONFIG_LWIP_MAX_SOCKETS=16
CONFIG_AD2IOT_USE_WIFI=y
CONFIG_AD2IOT_USE_ETHERNET=y
CONFIG_AD2IOT_USE_INTERNAL_ETHERNET=y
CONFIG_MQTT_REPORT_DELETED_MESSAGES=y
CONFIG_MQTT_PROTOCOL_311=y
CONFIG_MQTT_TRANSPORT_SSL=y
CONFIG_MQTT_TRANSPORT_WEBSOCKET=y
CONFIG_MQTT_MSG_ID_INCREMENTAL=y
CONFIG_MQTT_CUSTOM_OUTBOX=y
CONFIG_ESP_HTTPS_SERVER_ENABLE=y
CONFIG_ESP_HTTP_CLIENT_ENABLE_HTTPS=y
CONFIG_HTTPD_WS_SUPPORT=y
CONFIG_MBEDTLS_CERTIFICATE_BUNDLE_DEFAULT_CMN=y
CONFIG_MBEDTLS_CUSTOM_CERTIFICATE_BUNDLE=y
CONFIG_MBEDTLS_CUSTOM_CERTIFICATE_BUNDLE_PATH="certs"
CONFIG_STDK_IOT_CORE=y
CONFIG_STDK_IOT_CORE_EASYSETUP_HTTP=y
CONFIG_STDK_IOT_CORE_LOG_LEVEL_ERROR=y
CONFIG_STDK_IOT_CORE_LOG_LEVEL_WARN=y
CONFIG_STDK_IOT_CORE_LOG_LEVEL_INFO=y
# CONFIG_STDK_IOT_CORE_SUPPORT_STNV_PARTITION is not set
CONFIG_STDK_IOT_CORE_LOG_FILE=y
CONFIG_STDK_IOT_CORE_LOG_FILE_RAM_ONLY=y
CONFIG_STDK_IOT_CORE_LOG_FILE_RAM_BUF_SIZE=8192
CONFIG_STDK_IOT_CORE_BSP_SUPPORT_ESP32=y
CONFIG_STDK_IOT_CORE_OS_SUPPORT_FREERTOS=y
CONFIG_STDK_IOT_CORE_USE_MBEDTLS=y
CONFIG_STDK_IOT_CORE_CRYPTO_SUPPORT_ED25519=y
CONFIG_STDK_IOT_CORE_SECURITY_BACKEND_SOFTWARE=y
CONFIG_STDK_IOT_CORE_FS_HW_ENCRYPTION=y
CONFIG_STDK_IOT_CORE_NET_MBEDTLS=y
CONFIG_AD2IOT_TWILIO_CLIENT=y
CONFIG_AD2IOT_PUSHOVER_CLIENT=y
CONFIG_AD2IOT_SER2SOCKD=y
CONFIG_AD2IOT_WEBSERVER_UI=y
CONFIG_AD2IOT_MQTT_CLIENT=y
```

## sdkconfig.defaults.stsdk
```kconfig
# Compiler settings
CONFIG_COMPILER_CXX_EXCEPTIONS=y
CONFIG_CXX_EXCEPTIONS=y
CONFIG_COMPILER_CXX_EXCEPTIONS_EMG_POOL_SIZE=0
CONFIG_CXX_EXCEPTIONS_EMG_POOL_SIZE=0
CONFIG_COMPILER_OPTIMIZATION_SIZE=y

# FreeRTOS settings
CONFIG_FREERTOS_UNICORE=y
CONFIG_FREERTOS_ISR_STACKSIZE=2096
CONFIG_FREERTOS_USE_STATS_FORMATTING_FUNCTIONS=y
CONFIG_FREERTOS_VTASKLIST_INCLUDE_COREID=y
CONFIG_FREERTOS_GENERATE_RUN_TIME_STATS=y
CONFIG_FREERTOS_USE_TRACE_FACILITY=y

# General settings
CONFIG_LOG_COLORS=n
CONFIG_BOOTLOADER_LOG_LEVEL_NONE=y
CONFIG_BOOTLOADER_LOG_LEVEL=0

# Hardware specific settings
CONFIG_ESP_INT_WDT_TIMEOUT_MS=3000
## ESP32-WROOM-32E
CONFIG_ESPTOOLPY_FLASHMODE_QIO=y
CONFIG_BOOTLOADER_SPI_WP_PIN=7
CONFIG_ESPTOOLPY_FLASHSIZE="4MB"
CONFIG_ESPTOOLPY_FLASHSIZE_4MB=y
## ESP32-POE-ISO ETHERNET config
CONFIG_ETH_USE_ESP32_EMAC=y
CONFIG_ETH_PHY_INTERFACE_RMII=y
CONFIG_ETH_RMII_CLK_OUT_GPIO=17
CONFIG_ETH_RMII_CLK_OUTPUT=y
CONFIG_AD2IOT_ETH_PHY_LAN8720=y
CONFIG_AD2IOT_ETH_MDC_GPIO=23
CONFIG_AD2IOT_ETH_MDIO_GPIO=18
CONFIG_AD2IOT_ETH_PHY_RST_GPIO=-1
CONFIG_AD2IOT_ETH_PHY_POWER_GPIO=12
CONFIG_AD2IOT_ETH_PHY_ADDR=0

# Partition settings
CONFIG_PARTITION_TABLE_CUSTOM=y
CONFIG_PARTITION_TABLE_CUSTOM_FILENAME="partitions.4MB.csv"
CONFIG_PARTITION_TABLE_FILENAME="partitions.4MB.csv"
CONFIG_PARTITION_TABLE_OFFSET=0x8000
CONFIG_PARTITION_TABLE_MD5=y

# FATFS settings
CONFIG_FATFS_LFN_HEAP=y
CONFIG_FATFS_CODEPAGE_437=y
CONFIG_FATFS_CODEPAGE=437
CONFIG_FATFS_CODEPAGE_437=y
CONFIG_FATFS_MAX_LFN=255
CONFIG_FATFS_API_ENCODING_ANSI_OEM=y
CONFIG_FATFS_FS_LOCK=0
CONFIG_FATFS_TIMEOUT_MS=10000
CONFIG_FATFS_PER_FILE_CACHE=y

# Coredump settings
CONFIG_ESP_COREDUMP_ENABLE=y
CONFIG_ESP_COREDUMP_ENABLE_TO_FLASH=y
CONFIG_ESP_COREDUMP_DATA_FORMAT_ELF=y
CONFIG_ESP_COREDUMP_CHECKSUM_CRC32=y
CONFIG_ESP_COREDUMP_CHECK_BOOT=y
CONFIG_ESP_COREDUMP_MAX_TASKS_NUM=20

# LWIP settings
CONFIG_LWIP_LOCAL_HOSTNAME="ad2iot"
CONFIG_LWIP_IPV6_AUTOCONFIG=y
CONFIG_LWIP_MAX_SOCKETS=16

# MQTT client settings
CONFIG_MQTT_PROTOCOL_311=y
CONFIG_MQTT_TRANSPORT_SSL=y
CONFIG_MQTT_TRANSPORT_WEBSOCKET=y
CONFIG_MQTT_MSG_ID_INCREMENTAL=y
CONFIG_MQTT_REPORT_DELETED_MESSAGES=y

# HTTP(s) / WebSockets server
CONFIG_ESP_HTTPS_SERVER_ENABLE=y
CONFIG_ESP_HTTP_CLIENT_ENABLE_HTTPS=y
CONFIG_ESP_HTTP_CLIENT_ENABLE_BASIC_AUTH=y
CONFIG_HTTPD_WS_SUPPORT=y
## TODO: Make better...
CONFIG_ESP_TLS_INSECURE=y
CONFIG_ESP_TLS_SKIP_SERVER_CERT_VERIFY=y

# SSL/TLS certificate bundles
CONFIG_MBEDTLS_CERTIFICATE_BUNDLE_DEFAULT_CMN=y
CONFIG_MBEDTLS_CUSTOM_CERTIFICATE_BUNDLE=y
CONFIG_MBEDTLS_CUSTOM_CERTIFICATE_BUNDLE_PATH="certs"

# STSDK build settings
CONFIG_STDK_IOT_CORE=y
CONFIG_STDK_IOT_CORE_BSP_SUPPORT_ESP32=y
CONFIG_STDK_IOT_CORE_EASYSETUP_HTTP=y
CONFIG_STDK_IOT_CORE_LOG_LEVEL_ERROR=y
CONFIG_STDK_IOT_CORE_LOG_LEVEL_WARN=y
# CONFIG_STDK_IOT_CORE_LOG_LEVEL_INFO is not set
# CONFIG_STDK_IOT_CORE_LOG_LEVEL_DEBUG is not set
# CONFIG_STDK_IOT_CORE_SUPPORT_STNV_PARTITION is not set

# AD2IoT network settings
CONFIG_AD2IOT_USE_WIFI=y
CONFIG_AD2IOT_USE_ETHERNET=y
CONFIG_AD2IOT_USE_INTERNAL_ETHERNET=y

# AD2IoT default components enable/disable
CONFIG_AD2IOT_TOP=n
CONFIG_AD2IOT_FTP_DAEMON=y
CONFIG_AD2IOT_MQTT_CLIENT=n
CONFIG_AD2IOT_WEBSERVER_UI=y
CONFIG_AD2IOT_SER2SOCKD=y
CONFIG_AD2IOT_TWILIO_CLIENT=y
CONFIG_AD2IOT_PUSHOVER_CLIENT=y
```
